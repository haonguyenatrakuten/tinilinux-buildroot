## package/rk3566-dtbo/Config.in
```kconfig
config BR2_PACKAGE_RK3566_DTBO
    bool "rk3566-dtbo"
    select BR2_PACKAGE_HOST_DTC
```

## package/sdl12-compat/Config.in
```kconfig
config BR2_PACKAGE_SDL12_COMPAT
    bool "sdl12-compat"
    select BR2_PACKAGE_SDL2
```

## package/simple-launcher/Config.in
```kconfig
config BR2_PACKAGE_SIMPLE_LAUNCHER
    bool "simple-launcher"
    select BR2_PACKAGE_SDL2
    help
      Simple Launcher program
```
